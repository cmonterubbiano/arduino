
/*
  Simple example for receiving
  
  http://code.google.com/p/rc-switch/
*/

#include <RCSwitch.h>
#include <IRremote.h>

IRsend irsend;

//You could also try 36,40 & 56 frequencies as a test NORMAL = 38
int khz = 38; //NB Change this default value as neccessary to the correct modulation frequency

RCSwitch mySwitch = RCSwitch();

char nomeRicettore[] ="Condizioantore Sala";
//char nomeRicettore = String("Condizioantore Camera Sud");
//char nomeRicettore = String("Condizioantore Camera Nord");
//char nomeRicettore = String("Stufa Bagno");

// toshiba mio accensione
unsigned int segnaleIR_1[] = {3400,1700,432,1298,432,1298,432,432,432,432,432,432,432,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432,432}; //AnalysIR Batch Export - RAW

//toshiba spegnimento
//unsigned int segnaleIR_4[] = {3472,1656,464,1248,480,1236,464,400,464,396,464,396,484,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1248,464};//AnalysIR Batch Export RAW


unsigned int signal1 = 10;
unsigned int signal2 = 210;
unsigned int signal3 = 410;
unsigned int signal4 = 610;
unsigned int incremento = 0;


void setup() {
  Serial.begin(9600);
  irsend.enableIROut(khz);
  delay(1000);
  Serial.println(F("AnalysIR"));
  pinMode(13, OUTPUT);

  
  if( !strcmp(nomeRicettore, "Condizioantore Sala")){incremento = 11000; }
  if( nomeRicettore == "Condizioantore Camera Sud" ){incremento = 21000; }
  if( nomeRicettore == "Condizioantore Camera Nord"){incremento = 31000; }
  if( nomeRicettore == "Stufa Bagno" ){incremento = 41000; }
  
  signal1 = signal1 + incremento;
  signal2 = signal2 + incremento;
  signal3 = signal3 + incremento;
  signal4 = signal4 + incremento;
  
  mySwitch.enableReceive(0);  // Receiver on inerrupt 0 => that is pin #2

      Serial.println(F("singal1: "));
      Serial.println(signal1);
      Serial.println(F("incremento: "));
      Serial.println(incremento);
      
}

void loop() {
  
  if (mySwitch.available()) {
    
    int value = mySwitch.getReceivedValue();
    
    if (value == 0) {
      Serial.print("Unknown encoding");
    } else {
      
      Serial.println(F("Received "));
      Serial.print( mySwitch.getReceivedValue() );
      Serial.print(" / ");
      //Serial.print( mySwitch.getReceivedBitlength() );

      //signal1 = 12844044; //per Debug
      if(value == signal1){ eseguiIR_1(); }
//      if(value == signal2){ eseguiIR( segnaleIR_2 ); }
//      if(value == signal3){ eseguiIR( segnaleIR_3 ); }
//      if(value == signal4){ eseguiIR_4(); }
      
    }

    mySwitch.resetAvailable();
    
  }
  
}


void eseguiIR_1() {
  Serial.println(F("sending IR "));
  digitalWrite(13, HIGH);   // turn the LED on (HIGH is the voltage level)
  irsend.sendRaw(segnaleIR_1, sizeof(segnaleIR_1)/sizeof(int), khz); //AnalysIR Batch Export (IRremote) - RAW
   // AnalysIR IR Protocol: MITSUBISHI288AC, Key:  
  delay(500);              // wait for a 1/2 second
  digitalWrite(13, LOW);  // turn the LED off by making the voltage LOW     
  delay(1000);
}

/*
void eseguiIR_4() {
  Serial.println(F("sending IR "));
  digitalWrite(13, HIGH);   // turn the LED on (HIGH is the voltage level)
  irsend.sendRaw(segnaleIR_4, sizeof(segnaleIR_4)/sizeof(int), khz); //AnalysIR Batch Export (IRremote) - RAW
   // AnalysIR IR Protocol: MITSUBISHI288AC, Key:  
  delay(500);              // wait for a 1/2 second
  digitalWrite(13, LOW);  // turn the LED off by making the voltage LOW     
  delay(1000);
}
*/



