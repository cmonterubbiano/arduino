#define  NA  1

byte  npul[] ={ 6,  7,  5};  //Numero pulsanti arduino
byte  ppin[] ={  22,  2,  3,  4,  5,  6,  22,  24,  26,  28,  30,  32,  34,
                 22,  2,  3,  4,  5,  6};//Numero del pin
byte  appu[] ={  0,  0,  0,  0,  0,  0,  0,  1,  0,  0,  0,  0,  0,
                 0,  0,  0,  0,  0,  0};//piastre  abbinamento pulsanti
byte  papu[] ={  0,  0,  0,  0,  0,  0,  0,  1,  0,  0,  0,  0,  0,
                 0,  0,  0,  0,  0,  0};//pulsanti abbinamento pulsanti
byte  sepu[] ={  0,  0,  0,  0,  0,  0,  4,  4,  0,  0,  0,  0,  0,
                 0,  0,  0,  0,  0,  0};//sequenza massima pulsanti 1-2-4-8-16-32 etc.
byte  psta[] ={  0,  0,  0,  0,  0,  0,  0,  0,  0,  0,  0,  0,  0,
                 0,  0,  0,  0,  0,  0};//stato attuale pulsanti
unsigned  long  spul[] ={  0,  0,  0,  0,  0,  0,  0,  0,  0,  0,  0,  0,  0,
                           0,  0,  0,  0,  0,  0};//Millisecondo inzio pressione pulsante                 
                
byte  rele[] ={  8,  5,  6}; //Numero rele arduino
byte  rpin[] ={  1,  2,  3,  4,  5,  6,  7,  8,  23,  25,  27,  29,  31,
                1,  2,  3,  4,  5,  6};//Numero del pin
byte  roff[] ={  1,  0,  0,  1,  0,  0,  1,  0,  0,  1,  0,  0,
                 1,  0,  0,  1,  0,  0,  0};//Status off rele
byte  rsta[] ={  0,  0,  0,  0,  0,  0,  0,  0,  0,  0,  0,  0,
                 0,  0,  0,  0,  0,  0,  0};// status attuale 0 off 1 on
                 
#define  NARD  3  //Numero di arduini configurabili
#define  NPUL  20 //Numero di pulsanti/arduino configurabili
#define  NREL  20 //Numero di     rele/arduino configurabili

                 /* ogni riga rappresenta i potenziali 20 pulsanti di ogni piastra
                    i numeri corrispondono alla sequenza di accensione primo impulso 1
                    secondo 2 terzo 4 quarto  8  etc. etc.                              */
byte  rabb[(NARD * NREL)][(NARD *NPUL)] =
                    {0,0,0,0,0,0,0,0,0,0,0,0,0,0,0,0,0,0,0,0,  // rele 1 piastra 1
                     0,0,0,0,0,0,0,0,0,0,0,0,0,0,0,0,0,0,0,0,
                     0,0,0,0,0,0,0,0,0,0,0,0,0,0,0,0,0,0,0,0,
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                     0,0,0,0,0,0,0,0,0,0,0,0,0,0,0,0,0,0,0,0};
                     
byte  pulini;
byte  relini; 

#define  TMIN  10   //tempo minimo pressione pulsante in millesecondi
#define  TREP  3000 //tempo reset parziale ambiente
#define  TREG  10000//tempo reset generale

char  datrasf[256];
char  ricevut[256];


void setup()
{
  int  iy;
  int  iz;
  
  *ricevut =*datrasf ='\0';
  Serial.begin(9600);
  delay(20);
  for (pulini =iy =0; iy <NA; pulini +=npul[iy], iy++);
  Serial.print("IX ");
  Serial.print(npul[NA]);
  Serial.print(" IZ ");
  Serial.println(pulini);
  iz =pulini;

  for (iy =iz +npul[NA]; iz <iy; iz++)
  {
    pinMode(ppin[iz], INPUT);
    Serial.print("INPUT ");
    Serial.println(ppin[iz]);
    delay(20);
  }

  for (iy =iz =0; iy <NA; iz +=rele[iy], iy++);
  relini =iz;
  Serial.begin(9600);
  for (iy =iz +rele[NA]; iz <iy; iz++)
  {
    pinMode(rpin[iz], OUTPUT);
    Serial.print("OUTPUT ");
    Serial.println(rpin[iz]);
    delay(20);
  }
  Serial.println("FINE");
}

void loop()
{
  int  pulsa;
  
  for(pulsa =0; pulsa <npul[NA]; pulsa++)
  {
    int  pulsante =pulini +pulsa;
    int  pulstat =digitalRead(ppin[pulsante]);
    
//    Serial.print("Pulsante ");
//    Serial.print(ppin[pulsante]);
//    Serial.print(" Stato ");
//    Serial.println(pulstat);
    if (pulstat)
    {
      if (!spul[pulsante])
      {
        spul[pulsante] =millis();
        Serial.print("ON Pulsante ");
        Serial.println(ppin[pulsante]);
      }
    }
    else  if (spul[pulsante])
    {
      unsigned  long  diff =(millis() -spul[pulsante]);
      
      spul[pulsante] =0;
      
      if (diff >TMIN  && diff <TREP)
      {
        int  esegui =1;
 //       int  ix =0;
        
        Serial.print("Tempo normale ");
        Serial.print("Pulsante ");
        Serial.print(pulsante);
        Serial.print(" papu ");
        Serial.println(papu[pulsante]);
        if (papu[pulsante])
        {
          if (appu[pulsante] ==NA)
          {
            Serial.print("Pulsante prima ");
            Serial.print(ppin[pulsante]);
            psta[pulsante] =0;
            pulsante =(pulini +papu[pulsante] -1);
            Serial.print(" Pulsante dopo ");
            Serial.println(ppin[pulsante]);
          }
          else
          {
            char  mess[10];
             
            esegui =0;
            sprintf(mess, "p,%01d,%02d", appu[pulsante], papu[pulsante]);
            strcpy(&datrasf[(strlen(datrasf))], mess);
            Serial.print("Stack da trasferire ");
            Serial.println(mess);
          }
        } 
        if (esegui)
        {
          int  posrel =((pulsante -pulini) +(NA *NREL));  // posizione del pulsante relativa.
          int  sequenza;
          
          if (!psta[pulsante])
            psta[pulsante] =1;
          else
          {
            psta[pulsante] =(psta[pulsante] <<1);
            Serial.print(" Dopo shift ");
            Serial.println(psta[pulsante]);
            if (psta[pulsante] >sepu[pulsante])
              psta[pulsante] =0;
            Serial.print(" Dopo sequ ");
            Serial.println(psta[pulsante]);
          }
          sequenza =psta[pulsante];
 //         for (ix =0; ix <NARD; ix++)
          {
            int  iy;

            for (iy =0; iy <(NARD *NREL); iy++)
           // for (iy =0; iy <(NARD *NREL); posrel +=(NARD +NPUL))
            {
              Serial.print("iy ");
              Serial.print(iy);
              Serial.print(" posrel ");
              Serial.print(posrel);
              Serial.print(" rabb ");
              Serial.print(rabb[iy][posrel]);
              Serial.print(" sequenza ");
              Serial.print(sequenza);
              if (!rabb[iy][posrel])
              {
                Serial.println("continue");
                continue;
              }
              if (rabb[iy][posrel] & sequenza)
              {
                if (iy >=(NA *NREL) && iy <(NA * NREL +NREL))
                {
                  int  nrel =rpin[(iy -(NA *NREL) +relini)];
                  digitalWrite(nrel, HIGH);
                  rsta[(iy -(NA *NREL) +relini)] =1;
                  Serial.print(" Rele HIGH ");
                  Serial.println(nrel);
                }
                else
                {
                  char  mess[10];
             
                  sprintf(mess, "r,%01d,%02d,1", (iy /NREL), (iy % NREL));
                  strcpy(&datrasf[(strlen(datrasf))], mess);
                  Serial.print("Stack da trasferire ");
                  Serial.println(mess);
                }
              }
              else
              {
                if (iy >=(NA *NREL) && iy <(NA * NREL +NREL))
                {
                  int  nrel =rpin[(iy -(NA *NREL) +relini)];
                  digitalWrite(nrel, LOW);
                  rsta[(iy -(NA *NREL) +relini)] =0;
                  Serial.print(" Rele LOW ");
                  Serial.println(nrel);
                }
                else
                {
                  char  mess[10];
             
                  sprintf(mess, "r,%01d,%02d,0", (iy /NREL), (iy % NREL));
                  strcpy(&datrasf[(strlen(datrasf))], mess);
                  Serial.print("Stack da trasferire ");
                  Serial.println(mess);
		}
              }
            }
          }
        }
      }
      else  if (diff >=TREP && diff <TREG)
      {
        Serial.print("Reset parziale ");
      }
      else  if (diff >=TREG)
      {
        Serial.print("Reset generale ");
      }
      Serial.print("Off Pulsante ");
      Serial.print(ppin[pulsante]);
      Serial.print(" tempo ");
      Serial.println(diff);
    }
    delay(1);
  }
  if (*datrasf)
	esegui_trasf();
}

void esegui_trasf()
{
 Serial.print("Buffer da trasferire ");
 Serial.println(datrasf);
}
